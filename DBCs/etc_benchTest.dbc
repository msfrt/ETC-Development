VERSION ""

NS_ :

BS_:

BU_:

BO_ 106 Msg_6: 4 Vector__XXX
 SG_ motorOut2Voltage : 0|32@1+ (0.01,0) [0|0] "V" Vector__XXX

BO_ 105 Msg_5: 4 Vector__XXX
 SG_ motorOut1Voltage : 0|32@1+ (0.01,0) [0|0] "V" Vector__XXX

BO_ 104 Msg_4: 4 Vector__XXX
 SG_ batteryVoltage : 0|32@1+ (0.01,0) [0|0] "V" Vector__XXX

BO_ 103 Msg_3: 4 Vector__XXX
 SG_ motorCurrent : 0|32@1+ (0.01,0) [0|0] "A" Vector__XXX

BO_ 102 Msg_2: 4 Vector__XXX
 SG_ motorEnable : 0|32@1+ (1,0) [0|4294967295] "bool" Vector__XXX

BO_ 101 Msg_1: 4 Vector__XXX
 SG_ motor1PWM : 0|32@1+ (1,0) [0|4294967295] "%" Vector__XXX

BO_ 100 Msg_0: 4 Vector__XXX
 SG_ motor2PWM : 0|32@1+ (1,0) [0|4294967295] "%" Vector__XXX
