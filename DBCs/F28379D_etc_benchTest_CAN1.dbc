VERSION ""

NS_ :

BS_:

BU_:
VAL_TABLE_ ETC_subModes 4 "Position Control" 3 "PWM Control" 2 "Calibration" 1 "Normal" 0 "Disabled" ;
VAL_TABLE_ ETC_modes 3 "Diagnostic" 2 "Run" 1 "Standby" 0 "ESTOP" ;
VAL_TABLE_ motorControlModes 2 "Position" 1 "PWM" 0 "Off" ;
VAL_TABLE_ throttlePosInputModes 2 "VectorBox" 1 "CCP" 0 "Disabled" ;

BO_ 500 USER_cmd1: 2 Vector__XXX
 SG_ USER_throttleCmd : 0|16@1- (0.01,0) [-327.68|327.67] "" Vector__XXX
