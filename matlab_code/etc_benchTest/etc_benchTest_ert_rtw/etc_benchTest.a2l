/******************************************************************************
* ASAP2 file: etc_benchTest.a2l
* Sponsored License - for use in support of a program or activity
* sponsored by MathWorks. Not for government, commercial or other
* non-sponsored organizational use.
* Code generation for model "etc_benchTest".
* Model version : 1.75
* Simulink Coder version : 9.2 (R2019b) 18-Jul-2019
* C source code generated on : Sat Feb 13 14:55:09 2021
* Target selection: ert.tlc
* Embedded hardware selection: Texas Instruments->C2000
* Code generation objectives: Unspecified
* Validation result: Not run
* (add additional file header information here)
******************************************************************************/ ASAP2_VERSION 1 31
/* Version 1.31 */
/begin PROJECT ProjectName "Project Comment Goes Here"
/begin HEADER "Header Comments go here" /end HEADER
/begin MODULE ModuleName "Module Comment Goes Here"
/begin MOD_PAR "MOD PAR Comment Goes Here" /end MOD_PAR
/begin MOD_COMMON "Mod Common Comment Here" BYTE_ORDER MSB_LAST /end MOD_COMMON
/begin RECORD_LAYOUT Scalar_BOOLEAN FNC_VALUES 1 UBYTE COLUMN_DIR DIRECT /end RECORD_LAYOUT
/begin RECORD_LAYOUT Scalar_UBYTE FNC_VALUES 1 UBYTE COLUMN_DIR DIRECT /end RECORD_LAYOUT
/begin RECORD_LAYOUT Scalar_BYTE FNC_VALUES 1 SBYTE COLUMN_DIR DIRECT /end RECORD_LAYOUT
/begin RECORD_LAYOUT Scalar_UWORD FNC_VALUES 1 UWORD COLUMN_DIR DIRECT /end RECORD_LAYOUT
/begin RECORD_LAYOUT Scalar_SWORD FNC_VALUES 1 SWORD COLUMN_DIR DIRECT /end RECORD_LAYOUT
/begin RECORD_LAYOUT Scalar_ULONG FNC_VALUES 1 ULONG COLUMN_DIR DIRECT /end RECORD_LAYOUT
/begin RECORD_LAYOUT Scalar_LONG FNC_VALUES 1 SLONG COLUMN_DIR DIRECT /end RECORD_LAYOUT
/begin RECORD_LAYOUT Scalar_FLOAT32_IEEE FNC_VALUES 1 FLOAT32_IEEE COLUMN_DIR DIRECT /end RECORD_LAYOUT
/begin RECORD_LAYOUT Scalar_FLOAT64_IEEE FNC_VALUES 1 FLOAT64_IEEE COLUMN_DIR DIRECT /end RECORD_LAYOUT
/begin RECORD_LAYOUT Lookup1D_BOOLEAN FNC_VALUES 1 UBYTE COLUMN_DIR DIRECT /end RECORD_LAYOUT
/begin RECORD_LAYOUT Lookup1D_X_BOOLEAN AXIS_PTS_X 1 UBYTE INDEX_INCR DIRECT /end RECORD_LAYOUT
/begin RECORD_LAYOUT Lookup1D_BYTE FNC_VALUES 1 SBYTE COLUMN_DIR DIRECT /end RECORD_LAYOUT
/begin RECORD_LAYOUT Lookup1D_X_BYTE AXIS_PTS_X 1 SBYTE INDEX_INCR DIRECT /end RECORD_LAYOUT
/begin RECORD_LAYOUT Lookup1D_UBYTE FNC_VALUES 1 UBYTE COLUMN_DIR DIRECT /end RECORD_LAYOUT
/begin RECORD_LAYOUT Lookup1D_X_UBYTE AXIS_PTS_X 1 UBYTE INDEX_INCR DIRECT /end RECORD_LAYOUT
/begin RECORD_LAYOUT Lookup1D_UWORD FNC_VALUES 1 UWORD COLUMN_DIR DIRECT /end RECORD_LAYOUT
/begin RECORD_LAYOUT Lookup1D_X_UWORD AXIS_PTS_X 1 UWORD INDEX_INCR DIRECT /end RECORD_LAYOUT
/begin RECORD_LAYOUT Lookup1D_WORD FNC_VALUES 1 SWORD COLUMN_DIR DIRECT /end RECORD_LAYOUT
/begin RECORD_LAYOUT Lookup1D_X_WORD AXIS_PTS_X 1 SWORD INDEX_INCR DIRECT /end RECORD_LAYOUT
/begin RECORD_LAYOUT Lookup1D_ULONG FNC_VALUES 1 ULONG COLUMN_DIR DIRECT /end RECORD_LAYOUT
/begin RECORD_LAYOUT Lookup1D_X_ULONG AXIS_PTS_X 1 ULONG INDEX_INCR DIRECT /end RECORD_LAYOUT
/begin RECORD_LAYOUT Lookup1D_SLONG FNC_VALUES 1 SLONG COLUMN_DIR DIRECT /end RECORD_LAYOUT
/begin RECORD_LAYOUT Lookup1D_X_LONG AXIS_PTS_X 1 SLONG INDEX_INCR DIRECT /end RECORD_LAYOUT
/begin RECORD_LAYOUT Lookup1D_FLOAT32_IEEE FNC_VALUES 1 FLOAT32_IEEE COLUMN_DIR DIRECT /end RECORD_LAYOUT
/begin RECORD_LAYOUT Lookup1D_X_FLOAT32_IEEE AXIS_PTS_X 1 FLOAT32_IEEE INDEX_INCR DIRECT /end RECORD_LAYOUT
/begin RECORD_LAYOUT Lookup1D_FLOAT64_IEEE FNC_VALUES 1 FLOAT64_IEEE COLUMN_DIR DIRECT /end RECORD_LAYOUT
/begin RECORD_LAYOUT Lookup1D_X_FLOAT64_IEEE AXIS_PTS_X 1 FLOAT64_IEEE INDEX_INCR DIRECT /end RECORD_LAYOUT
/begin RECORD_LAYOUT Lookup2D_BOOLEAN FNC_VALUES 1 UBYTE COLUMN_DIR DIRECT /end RECORD_LAYOUT
/begin RECORD_LAYOUT Lookup2D_X_BOOLEAN AXIS_PTS_X 1 UBYTE INDEX_INCR DIRECT /end RECORD_LAYOUT
/begin RECORD_LAYOUT Lookup2D_UBYTE FNC_VALUES 1 UBYTE COLUMN_DIR DIRECT /end RECORD_LAYOUT
/begin RECORD_LAYOUT Lookup2D_X_UBYTE AXIS_PTS_X 1 UBYTE INDEX_INCR DIRECT /end RECORD_LAYOUT
/begin RECORD_LAYOUT Lookup2D_BYTE FNC_VALUES 1 SBYTE COLUMN_DIR DIRECT /end RECORD_LAYOUT
/begin RECORD_LAYOUT Lookup2D_X_BYTE AXIS_PTS_X 1 SBYTE INDEX_INCR DIRECT /end RECORD_LAYOUT
/begin RECORD_LAYOUT Lookup2D_UWORD FNC_VALUES 1 UWORD COLUMN_DIR DIRECT /end RECORD_LAYOUT
/begin RECORD_LAYOUT Lookup2D_X_UWORD AXIS_PTS_X 1 UWORD INDEX_INCR DIRECT /end RECORD_LAYOUT
/begin RECORD_LAYOUT Lookup2D_WORD FNC_VALUES 1 SWORD COLUMN_DIR DIRECT /end RECORD_LAYOUT
/begin RECORD_LAYOUT Lookup2D_X_WORD AXIS_PTS_X 1 SWORD INDEX_INCR DIRECT /end RECORD_LAYOUT
/begin RECORD_LAYOUT Lookup2D_ULONG FNC_VALUES 1 ULONG COLUMN_DIR DIRECT /end RECORD_LAYOUT
/begin RECORD_LAYOUT Lookup2D_X_ULONG AXIS_PTS_X 1 ULONG INDEX_INCR DIRECT /end RECORD_LAYOUT
/begin RECORD_LAYOUT Lookup2D_LONG FNC_VALUES 1 SLONG COLUMN_DIR DIRECT /end RECORD_LAYOUT
/begin RECORD_LAYOUT Lookup2D_X_LONG AXIS_PTS_X 1 SLONG INDEX_INCR DIRECT /end RECORD_LAYOUT
/begin RECORD_LAYOUT Lookup2D_FLOAT32_IEEE FNC_VALUES 1 FLOAT32_IEEE COLUMN_DIR DIRECT /end RECORD_LAYOUT
/begin RECORD_LAYOUT Lookup2D_X_FLOAT32_IEEE AXIS_PTS_X 1 FLOAT32_IEEE INDEX_INCR DIRECT /end RECORD_LAYOUT
/begin RECORD_LAYOUT Lookup2D_FLOAT64_IEEE FNC_VALUES 1 FLOAT64_IEEE COLUMN_DIR DIRECT /end RECORD_LAYOUT
/begin RECORD_LAYOUT Lookup2D_X_FLOAT64_IEEE AXIS_PTS_X 1 FLOAT64_IEEE INDEX_INCR DIRECT /end RECORD_LAYOUT
/begin CHARACTERISTIC etcModeCmd "" VALUE 0x0000c2c0 Scalar_UWORD 0 etc_benchTest_CM_etcModes_etcModes 0 3 /end CHARACTERISTIC
/begin CHARACTERISTIC etcSubModeCmd "" VALUE 0x0000c2c1 Scalar_UWORD 0 etc_benchTest_CM_etcSubModes_etcSubModes 0 4 /end CHARACTERISTIC
/begin CHARACTERISTIC throttlePosInputMode "" VALUE 0x0000c2c2 Scalar_UWORD 0 etc_benchTest_CM_throttlePosInputModes_throttlePosInputMode 0 2 /end CHARACTERISTIC
/begin CHARACTERISTIC battVoltFaultThresh_mV "" VALUE 0x0000c2c3 Scalar_UWORD 0 etc_benchTest_CM_uint16_mV 0.0 20000.0 /end CHARACTERISTIC
/begin CHARACTERISTIC model_springConstant "" VALUE 0x0000c2c4 Scalar_UWORD 0 etc_benchTest_CM_uint16_mNM 0.0 1000.0 /end CHARACTERISTIC
/begin CHARACTERISTIC model_springPreload "" VALUE 0x0000c2c5 Scalar_UWORD 0 etc_benchTest_CM_uint16_mNM 0.0 1000.0 /end CHARACTERISTIC
/begin CHARACTERISTIC motor1PWM "" VALUE 0x0000c2c6 Scalar_UWORD 0 etc_benchTest_CM_uint16_pct 0.0 100.0 /end CHARACTERISTIC
/begin CHARACTERISTIC motor2PWM "" VALUE 0x0000c2c7 Scalar_UWORD 0 etc_benchTest_CM_uint16_pct 0.0 100.0 /end CHARACTERISTIC
/begin CHARACTERISTIC motorCurrZero_mV "" VALUE 0x0000c2c8 Scalar_UWORD 0 etc_benchTest_CM_uint16_mV 0.0 3300.0 /end CHARACTERISTIC
/begin CHARACTERISTIC motorPWMFreq "" VALUE 0x0000c2c9 Scalar_UWORD 0 etc_benchTest_CM_uint16_Hz 0.0 60000.0 /end CHARACTERISTIC
/begin CHARACTERISTIC motorPosCommand_deg "" VALUE 0x0000c2ca Scalar_UWORD 0 etc_benchTest_CM_uint16_cnt 0.0 90.0 /end CHARACTERISTIC
/begin CHARACTERISTIC motorPosGainI "" VALUE 0x0000c2cb Scalar_UWORD 0 etc_benchTest_CM_uint16_mCount 0.0 10000.0 /end CHARACTERISTIC
/begin CHARACTERISTIC motorPosGainP "" VALUE 0x0000c2cc Scalar_UWORD 0 etc_benchTest_CM_uint16_mCount 0.0 10000.0 /end CHARACTERISTIC
/begin CHARACTERISTIC motorVelGainFeedback "" VALUE 0x0000c2cd Scalar_UWORD 0 etc_benchTest_CM_uint16_mCount 0.0 10000.0 /end CHARACTERISTIC
/begin CHARACTERISTIC motorVelGainI "" VALUE 0x0000c2ce Scalar_UWORD 0 etc_benchTest_CM_uint16_mCount 0.0 10000.0 /end CHARACTERISTIC
/begin CHARACTERISTIC motorVelGainP "" VALUE 0x0000c2cf Scalar_UWORD 0 etc_benchTest_CM_uint16_mCount 0.0 10000.0 /end CHARACTERISTIC
/begin CHARACTERISTIC throttlePos1Max_cnt "" VALUE 0x0000c2d0 Scalar_UWORD 0 etc_benchTest_CM_uint16_cnt 0.0 4095.0 /end CHARACTERISTIC
/begin CHARACTERISTIC throttlePos1Min_cnt "" VALUE 0x0000c2d1 Scalar_UWORD 0 etc_benchTest_CM_uint16_cnt 0.0 4095.0 /end CHARACTERISTIC
/begin CHARACTERISTIC throttlePos2Max_cnt "" VALUE 0x0000c2d2 Scalar_UWORD 0 etc_benchTest_CM_uint16_cnt 0.0 4095.0 /end CHARACTERISTIC
/begin CHARACTERISTIC throttlePos2Min_cnt "" VALUE 0x0000c2d3 Scalar_UWORD 0 etc_benchTest_CM_uint16_cnt 0.0 4095.0 /end CHARACTERISTIC
/begin COMPU_METHOD etc_benchTest_CM_etcModes_etcModes "Enumerated data type: etcModes" TAB_VERB "%0.6" "etcModes" COMPU_TAB_REF VTAB_FOR_etc_benchTest_CM_etcModes_etcModes /end COMPU_METHOD
/begin COMPU_VTAB VTAB_FOR_etc_benchTest_CM_etcModes_etcModes "Enumerated data type: etcModes" TAB_VERB 4 0 "etcModes_ESTOP" 1 "etcModes_Standby" 2 "etcModes_Run" 3 "etcModes_Diag" /end COMPU_VTAB
/begin COMPU_METHOD etc_benchTest_CM_etcSubModes_etcSubModes "Enumerated data type: etcSubModes" TAB_VERB "%0.6" "etcSubModes" COMPU_TAB_REF VTAB_FOR_etc_benchTest_CM_etcSubModes_etcSubModes /end COMPU_METHOD
/begin COMPU_VTAB VTAB_FOR_etc_benchTest_CM_etcSubModes_etcSubModes "Enumerated data type: etcSubModes" TAB_VERB 5 0 "etcSubModes_Disabled" 1 "etcSubModes_Normal" 2 "etcSubModes_Calibration" 3 "etcSubModes_PWMControl" 4 "etcSubModes_PositionControl" /end COMPU_VTAB
/begin COMPU_METHOD etc_benchTest_CM_throttlePosInputModes_throttlePosInputMode "Enumerated data type: throttlePosInputModes" TAB_VERB "%0.6" "throttlePosInputMode" COMPU_TAB_REF VTAB_FOR_etc_benchTest_CM_throttlePosInputModes_throttlePosInputMode /end COMPU_METHOD
/begin COMPU_VTAB VTAB_FOR_etc_benchTest_CM_throttlePosInputModes_throttlePosInputMode "Enumerated data type: throttlePosInputModes" TAB_VERB 3 0 "throttlePosInputModes_Disabled" 1 "throttlePosInputModes_CCP" 2 "throttlePosInputModes_VectorBox" /end COMPU_VTAB
/begin COMPU_METHOD etc_benchTest_CM_uint16_mV "Q = V" RAT_FUNC "%5.0" "mV" COEFFS 0 1 0 0 0 1 /end COMPU_METHOD
/begin COMPU_METHOD etc_benchTest_CM_uint16_mNM "Q = V" RAT_FUNC "%5.0" "mNM" COEFFS 0 1 0 0 0 1 /end COMPU_METHOD
/begin COMPU_METHOD etc_benchTest_CM_uint16_pct "Q = V" RAT_FUNC "%5.0" "pct" COEFFS 0 1 0 0 0 1 /end COMPU_METHOD
/begin COMPU_METHOD etc_benchTest_CM_uint16_Hz "Q = V" RAT_FUNC "%5.0" "Hz" COEFFS 0 1 0 0 0 1 /end COMPU_METHOD
/begin COMPU_METHOD etc_benchTest_CM_uint16_cnt "Q = V" RAT_FUNC "%5.0" "cnt" COEFFS 0 1 0 0 0 1 /end COMPU_METHOD
/begin COMPU_METHOD etc_benchTest_CM_uint16_mCount "Q = V" RAT_FUNC "%5.0" "mCount" COEFFS 0 1 0 0 0 1 /end COMPU_METHOD
/begin GROUP etc_benchTest "etc_benchTest" /* Root */ ROOT /begin SUB_GROUP Root_Application /end SUB_GROUP /end GROUP
/begin GROUP Root_Application "etc_benchTest/Application" /begin SUB_GROUP S1_ETCControl S1_HardwareOutputs /end SUB_GROUP /end GROUP
/begin GROUP S1_ETCControl "etc_benchTest/Application/ETCControl" /begin SUB_GROUP S4_DiagnosticManagement S4_InputFiltering S4_SystemControl /end SUB_GROUP /end GROUP
/begin GROUP S1_HardwareOutputs "etc_benchTest/Application/HardwareOutputs" /begin SUB_GROUP S6_HO_AnalogOutputs /end SUB_GROUP /end GROUP
/begin GROUP S4_DiagnosticManagement "etc_benchTest/Application/ETCControl/DiagnosticManagement" /begin SUB_GROUP S7_DM_ETBModel S7_DM_SystemDiagnostics /end SUB_GROUP /end GROUP
/begin GROUP S4_InputFiltering "etc_benchTest/Application/ETCControl/InputFiltering" /begin SUB_GROUP S8_AnalogInputFiltering /end SUB_GROUP /end GROUP
/begin GROUP S4_SystemControl "etc_benchTest/Application/ETCControl/SystemControl" /begin SUB_GROUP S9_modeControl S9_motorControl /end SUB_GROUP /end GROUP
/begin GROUP S6_HO_AnalogOutputs "etc_benchTest/Application/HardwareOutputs/HO_AnalogOutputs" /begin SUB_GROUP S171_motorControls /end SUB_GROUP /end GROUP
/begin GROUP S7_DM_ETBModel "etc_benchTest/Application/ETCControl/DiagnosticManagement/DM_ETBModel" /begin SUB_GROUP S10_ETC_Hardware /end SUB_GROUP /end GROUP
/begin GROUP S7_DM_SystemDiagnostics "etc_benchTest/Application/ETCControl/DiagnosticManagement/DM_SystemDiagnostics" /begin REF_CHARACTERISTIC battVoltFaultThresh_mV /end REF_CHARACTERISTIC /end GROUP
/begin GROUP S8_AnalogInputFiltering "etc_benchTest/Application/ETCControl/InputFiltering/AnalogInputFiltering" /begin SUB_GROUP S24_ConvertToThrottlePos1 S24_ConvertToThrottlePos2 /end SUB_GROUP /begin REF_CHARACTERISTIC motorCurrZero_mV /end REF_CHARACTERISTIC /end GROUP
/begin GROUP S9_modeControl "etc_benchTest/Application/ETCControl/SystemControl/modeControl" /begin REF_CHARACTERISTIC etcModeCmd etcSubModeCmd /end REF_CHARACTERISTIC /end GROUP
/begin GROUP S9_motorControl "etc_benchTest/Application/ETCControl/SystemControl/motorControl" /begin SUB_GROUP S36_Position_Control /end SUB_GROUP
 /begin REF_CHARACTERISTIC motor1PWM motor2PWM motorPosCommand_deg throttlePosInputMode /end REF_CHARACTERISTIC
/end GROUP
/begin GROUP S171_motorControls "etc_benchTest/Application/HardwareOutputs/HO_AnalogOutputs/motorControls" /begin REF_CHARACTERISTIC motorPWMFreq /end REF_CHARACTERISTIC /end GROUP
/begin GROUP S10_ETC_Hardware "etc_benchTest/Application/ETCControl/DiagnosticManagement/DM_ETBModel/ETC Hardware" /begin REF_CHARACTERISTIC model_springConstant model_springPreload /end REF_CHARACTERISTIC /end GROUP
/begin GROUP S24_ConvertToThrottlePos1 "etc_benchTest/Application/ETCControl/InputFiltering/AnalogInputFiltering/ConvertToThrottlePos1" /begin REF_CHARACTERISTIC throttlePos1Max_cnt throttlePos1Min_cnt /end REF_CHARACTERISTIC /end GROUP
/begin GROUP S24_ConvertToThrottlePos2 "etc_benchTest/Application/ETCControl/InputFiltering/AnalogInputFiltering/ConvertToThrottlePos2" /begin REF_CHARACTERISTIC throttlePos2Max_cnt throttlePos2Min_cnt /end REF_CHARACTERISTIC /end GROUP
/begin GROUP S36_Position_Control "etc_benchTest/Application/ETCControl/SystemControl/motorControl/Position Control"
 /begin REF_CHARACTERISTIC motorPosGainI motorPosGainP motorVelGainFeedback motorVelGainI motorVelGainP /end REF_CHARACTERISTIC
/end GROUP
/end MODULE
/end PROJECT
/* (add any file trailer comments here) */
/* EOF etc_benchTest.a2l */
