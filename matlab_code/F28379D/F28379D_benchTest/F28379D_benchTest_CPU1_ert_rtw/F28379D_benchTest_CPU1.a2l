/******************************************************************************
* ASAP2 file: F28379D_benchTest_CPU1.a2l
* Sponsored License - for use in support of a program or activity
* sponsored by MathWorks. Not for government, commercial or other
* non-sponsored organizational use.
* Code generation for model "F28379D_benchTest_CPU1".
* Model version : 1.77
* Simulink Coder version : 9.2 (R2019b) 18-Jul-2019
* C source code generated on : Fri Mar 26 15:11:30 2021
* Target selection: ert.tlc
* Embedded hardware selection: Texas Instruments->C2000
* Code generation objectives: Unspecified
* Validation result: Not run
* (add additional file header information here)
******************************************************************************/ ASAP2_VERSION 1 31
/* Version 1.31 */
/begin PROJECT ProjectName "Project Comment Goes Here"
/begin HEADER "Header Comments go here" /end HEADER
/begin MODULE ModuleName "Module Comment Goes Here"
/begin MOD_PAR "MOD PAR Comment Goes Here" /end MOD_PAR
/begin MOD_COMMON "Mod Common Comment Here" BYTE_ORDER MSB_LAST /end MOD_COMMON
/begin RECORD_LAYOUT Scalar_BOOLEAN FNC_VALUES 1 UBYTE COLUMN_DIR DIRECT /end RECORD_LAYOUT
/begin RECORD_LAYOUT Scalar_UBYTE FNC_VALUES 1 UBYTE COLUMN_DIR DIRECT /end RECORD_LAYOUT
/begin RECORD_LAYOUT Scalar_BYTE FNC_VALUES 1 SBYTE COLUMN_DIR DIRECT /end RECORD_LAYOUT
/begin RECORD_LAYOUT Scalar_UWORD FNC_VALUES 1 UWORD COLUMN_DIR DIRECT /end RECORD_LAYOUT
/begin RECORD_LAYOUT Scalar_SWORD FNC_VALUES 1 SWORD COLUMN_DIR DIRECT /end RECORD_LAYOUT
/begin RECORD_LAYOUT Scalar_ULONG FNC_VALUES 1 ULONG COLUMN_DIR DIRECT /end RECORD_LAYOUT
/begin RECORD_LAYOUT Scalar_LONG FNC_VALUES 1 SLONG COLUMN_DIR DIRECT /end RECORD_LAYOUT
/begin RECORD_LAYOUT Scalar_FLOAT32_IEEE FNC_VALUES 1 FLOAT32_IEEE COLUMN_DIR DIRECT /end RECORD_LAYOUT
/begin RECORD_LAYOUT Scalar_FLOAT64_IEEE FNC_VALUES 1 FLOAT64_IEEE COLUMN_DIR DIRECT /end RECORD_LAYOUT
/begin RECORD_LAYOUT Lookup1D_BOOLEAN FNC_VALUES 1 UBYTE COLUMN_DIR DIRECT /end RECORD_LAYOUT
/begin RECORD_LAYOUT Lookup1D_X_BOOLEAN AXIS_PTS_X 1 UBYTE INDEX_INCR DIRECT /end RECORD_LAYOUT
/begin RECORD_LAYOUT Lookup1D_BYTE FNC_VALUES 1 SBYTE COLUMN_DIR DIRECT /end RECORD_LAYOUT
/begin RECORD_LAYOUT Lookup1D_X_BYTE AXIS_PTS_X 1 SBYTE INDEX_INCR DIRECT /end RECORD_LAYOUT
/begin RECORD_LAYOUT Lookup1D_UBYTE FNC_VALUES 1 UBYTE COLUMN_DIR DIRECT /end RECORD_LAYOUT
/begin RECORD_LAYOUT Lookup1D_X_UBYTE AXIS_PTS_X 1 UBYTE INDEX_INCR DIRECT /end RECORD_LAYOUT
/begin RECORD_LAYOUT Lookup1D_UWORD FNC_VALUES 1 UWORD COLUMN_DIR DIRECT /end RECORD_LAYOUT
/begin RECORD_LAYOUT Lookup1D_X_UWORD AXIS_PTS_X 1 UWORD INDEX_INCR DIRECT /end RECORD_LAYOUT
/begin RECORD_LAYOUT Lookup1D_WORD FNC_VALUES 1 SWORD COLUMN_DIR DIRECT /end RECORD_LAYOUT
/begin RECORD_LAYOUT Lookup1D_X_WORD AXIS_PTS_X 1 SWORD INDEX_INCR DIRECT /end RECORD_LAYOUT
/begin RECORD_LAYOUT Lookup1D_ULONG FNC_VALUES 1 ULONG COLUMN_DIR DIRECT /end RECORD_LAYOUT
/begin RECORD_LAYOUT Lookup1D_X_ULONG AXIS_PTS_X 1 ULONG INDEX_INCR DIRECT /end RECORD_LAYOUT
/begin RECORD_LAYOUT Lookup1D_SLONG FNC_VALUES 1 SLONG COLUMN_DIR DIRECT /end RECORD_LAYOUT
/begin RECORD_LAYOUT Lookup1D_X_LONG AXIS_PTS_X 1 SLONG INDEX_INCR DIRECT /end RECORD_LAYOUT
/begin RECORD_LAYOUT Lookup1D_FLOAT32_IEEE FNC_VALUES 1 FLOAT32_IEEE COLUMN_DIR DIRECT /end RECORD_LAYOUT
/begin RECORD_LAYOUT Lookup1D_X_FLOAT32_IEEE AXIS_PTS_X 1 FLOAT32_IEEE INDEX_INCR DIRECT /end RECORD_LAYOUT
/begin RECORD_LAYOUT Lookup1D_FLOAT64_IEEE FNC_VALUES 1 FLOAT64_IEEE COLUMN_DIR DIRECT /end RECORD_LAYOUT
/begin RECORD_LAYOUT Lookup1D_X_FLOAT64_IEEE AXIS_PTS_X 1 FLOAT64_IEEE INDEX_INCR DIRECT /end RECORD_LAYOUT
/begin RECORD_LAYOUT Lookup2D_BOOLEAN FNC_VALUES 1 UBYTE COLUMN_DIR DIRECT /end RECORD_LAYOUT
/begin RECORD_LAYOUT Lookup2D_X_BOOLEAN AXIS_PTS_X 1 UBYTE INDEX_INCR DIRECT /end RECORD_LAYOUT
/begin RECORD_LAYOUT Lookup2D_UBYTE FNC_VALUES 1 UBYTE COLUMN_DIR DIRECT /end RECORD_LAYOUT
/begin RECORD_LAYOUT Lookup2D_X_UBYTE AXIS_PTS_X 1 UBYTE INDEX_INCR DIRECT /end RECORD_LAYOUT
/begin RECORD_LAYOUT Lookup2D_BYTE FNC_VALUES 1 SBYTE COLUMN_DIR DIRECT /end RECORD_LAYOUT
/begin RECORD_LAYOUT Lookup2D_X_BYTE AXIS_PTS_X 1 SBYTE INDEX_INCR DIRECT /end RECORD_LAYOUT
/begin RECORD_LAYOUT Lookup2D_UWORD FNC_VALUES 1 UWORD COLUMN_DIR DIRECT /end RECORD_LAYOUT
/begin RECORD_LAYOUT Lookup2D_X_UWORD AXIS_PTS_X 1 UWORD INDEX_INCR DIRECT /end RECORD_LAYOUT
/begin RECORD_LAYOUT Lookup2D_WORD FNC_VALUES 1 SWORD COLUMN_DIR DIRECT /end RECORD_LAYOUT
/begin RECORD_LAYOUT Lookup2D_X_WORD AXIS_PTS_X 1 SWORD INDEX_INCR DIRECT /end RECORD_LAYOUT
/begin RECORD_LAYOUT Lookup2D_ULONG FNC_VALUES 1 ULONG COLUMN_DIR DIRECT /end RECORD_LAYOUT
/begin RECORD_LAYOUT Lookup2D_X_ULONG AXIS_PTS_X 1 ULONG INDEX_INCR DIRECT /end RECORD_LAYOUT
/begin RECORD_LAYOUT Lookup2D_LONG FNC_VALUES 1 SLONG COLUMN_DIR DIRECT /end RECORD_LAYOUT
/begin RECORD_LAYOUT Lookup2D_X_LONG AXIS_PTS_X 1 SLONG INDEX_INCR DIRECT /end RECORD_LAYOUT
/begin RECORD_LAYOUT Lookup2D_FLOAT32_IEEE FNC_VALUES 1 FLOAT32_IEEE COLUMN_DIR DIRECT /end RECORD_LAYOUT
/begin RECORD_LAYOUT Lookup2D_X_FLOAT32_IEEE AXIS_PTS_X 1 FLOAT32_IEEE INDEX_INCR DIRECT /end RECORD_LAYOUT
/begin RECORD_LAYOUT Lookup2D_FLOAT64_IEEE FNC_VALUES 1 FLOAT64_IEEE COLUMN_DIR DIRECT /end RECORD_LAYOUT
/begin RECORD_LAYOUT Lookup2D_X_FLOAT64_IEEE AXIS_PTS_X 1 FLOAT64_IEEE INDEX_INCR DIRECT /end RECORD_LAYOUT
/begin MEASUREMENT F28379D_benchTest_CPU1_B.ADC "" UWORD F28379D_benchTest_CPU1_CM_uint16 0 0 0 65535 ECU_ADDRESS 0x /end MEASUREMENT
/begin MEASUREMENT F28379D_benchTest_CPU1_B.eCANReceive_o2 "" UBYTE F28379D_benchTest_CPU1_CM_uint8 0 0 0 255 /* Array Size */ ARRAY_SIZE 8 ECU_ADDRESS 0x /end MEASUREMENT
/begin MEASUREMENT F28379D_benchTest_CPU1_DW.is_active_c1_c280xlib "" UBYTE F28379D_benchTest_CPU1_CM_uint8 0 0 0 255 ECU_ADDRESS 0x /end MEASUREMENT
/begin MEASUREMENT F28379D_benchTest_CPU1_DW.is_active_c28_canblocks_extras "" UBYTE F28379D_benchTest_CPU1_CM_uint8 0 0 0 255 ECU_ADDRESS 0x /end MEASUREMENT
/begin MEASUREMENT F28379D_benchTest_CPU1_DW.is_c28_canblocks_extras "" UBYTE F28379D_benchTest_CPU1_CM_uint8 0 0 0 255 ECU_ADDRESS 0x /end MEASUREMENT
/begin COMPU_METHOD /* Name of CompuMethod */ F28379D_benchTest_CPU1_CM_uint16 "Q = V" /* Conversion Type */ RAT_FUNC /* Format */ "%5.0" /* Units */ "" /* Coefficients */ COEFFS 0 1 0 0 0 1 /end COMPU_METHOD
/begin COMPU_METHOD /* Name of CompuMethod */ F28379D_benchTest_CPU1_CM_uint8 "Q = V" /* Conversion Type */ RAT_FUNC /* Format */ "%3.0" /* Units */ "" /* Coefficients */ COEFFS 0 1 0 0 0 1 /end COMPU_METHOD
/begin GROUP F28379D_benchTest_CPU1 "F28379D_benchTest_CPU1" /* Root */ ROOT /begin SUB_GROUP Root_Application Root_CAN_Calibration_Protocol /end SUB_GROUP /end GROUP
/begin GROUP Root_Application "F28379D_benchTest_CPU1/Application" /begin SUB_GROUP S1_HardwareInputs /end SUB_GROUP /end GROUP
/begin GROUP Root_CAN_Calibration_Protocol "F28379D_benchTest_CPU1/CAN Calibration Protocol" /begin SUB_GROUP S2_DTO_Processing /end SUB_GROUP /begin REF_MEASUREMENT F28379D_benchTest_CPU1_B.eCANReceive_o2 /end REF_MEASUREMENT /end GROUP
/begin GROUP S1_HardwareInputs "F28379D_benchTest_CPU1/Application/HardwareInputs" /begin SUB_GROUP S5_AnalogInputs /end SUB_GROUP /end GROUP
/begin GROUP S2_DTO_Processing "F28379D_benchTest_CPU1/CAN Calibration Protocol/DTO Processing" /begin SUB_GROUP S31_CCP /end SUB_GROUP /begin REF_MEASUREMENT F28379D_benchTest_CPU1_DW.is_active_c1_c280xlib /end REF_MEASUREMENT /end GROUP
/begin GROUP S5_AnalogInputs "F28379D_benchTest_CPU1/Application/HardwareInputs/AnalogInputs" /begin REF_MEASUREMENT F28379D_benchTest_CPU1_B.ADC /end REF_MEASUREMENT /end GROUP
/begin GROUP S31_CCP "F28379D_benchTest_CPU1/CAN Calibration Protocol/DTO Processing/CCP" /begin SUB_GROUP S33_CAN_Calibration_Protocol /end SUB_GROUP /end GROUP
/begin GROUP S33_CAN_Calibration_Protocol "F28379D_benchTest_CPU1/CAN Calibration Protocol/DTO Processing/CCP/CAN Calibration Protocol"
 /begin REF_MEASUREMENT F28379D_benchTest_CPU1_DW.is_active_c28_canblocks_extras F28379D_benchTest_CPU1_DW.is_c28_canblocks_extras /end REF_MEASUREMENT
/end GROUP
/end MODULE
/end PROJECT
/* (add any file trailer comments here) */
/* EOF F28379D_benchTest_CPU1.a2l */
