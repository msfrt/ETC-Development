/******************************************************************************
* ASAP2 file: F28379D_benchTest_CPU1.a2l
* Sponsored License - for use in support of a program or activity
* sponsored by MathWorks. Not for government, commercial or other
* non-sponsored organizational use.
* Code generation for model "F28379D_benchTest_CPU1".
* Model version : 1.89
* Simulink Coder version : 9.2 (R2019b) 18-Jul-2019
* C source code generated on : Thu Apr 1 14:26:09 2021
* Target selection: ert.tlc
* Embedded hardware selection: Texas Instruments->C2000
* Code generation objectives: Unspecified
* Validation result: Not run
* (add additional file header information here)
******************************************************************************/ ASAP2_VERSION 1 31
/* Version 1.31 */
/begin PROJECT ProjectName "Project Comment Goes Here"
/begin HEADER "Header Comments go here" /end HEADER
/begin MODULE ModuleName "Module Comment Goes Here"
/begin MOD_PAR "MOD PAR Comment Goes Here" /end MOD_PAR
/begin MOD_COMMON "Mod Common Comment Here" BYTE_ORDER MSB_LAST /end MOD_COMMON
/begin RECORD_LAYOUT Scalar_BOOLEAN FNC_VALUES 1 UBYTE COLUMN_DIR DIRECT /end RECORD_LAYOUT
/begin RECORD_LAYOUT Scalar_UBYTE FNC_VALUES 1 UBYTE COLUMN_DIR DIRECT /end RECORD_LAYOUT
/begin RECORD_LAYOUT Scalar_BYTE FNC_VALUES 1 SBYTE COLUMN_DIR DIRECT /end RECORD_LAYOUT
/begin RECORD_LAYOUT Scalar_UWORD FNC_VALUES 1 UWORD COLUMN_DIR DIRECT /end RECORD_LAYOUT
/begin RECORD_LAYOUT Scalar_SWORD FNC_VALUES 1 SWORD COLUMN_DIR DIRECT /end RECORD_LAYOUT
/begin RECORD_LAYOUT Scalar_ULONG FNC_VALUES 1 ULONG COLUMN_DIR DIRECT /end RECORD_LAYOUT
/begin RECORD_LAYOUT Scalar_LONG FNC_VALUES 1 SLONG COLUMN_DIR DIRECT /end RECORD_LAYOUT
/begin RECORD_LAYOUT Scalar_FLOAT32_IEEE FNC_VALUES 1 FLOAT32_IEEE COLUMN_DIR DIRECT /end RECORD_LAYOUT
/begin RECORD_LAYOUT Scalar_FLOAT64_IEEE FNC_VALUES 1 FLOAT64_IEEE COLUMN_DIR DIRECT /end RECORD_LAYOUT
/begin RECORD_LAYOUT Lookup1D_BOOLEAN FNC_VALUES 1 UBYTE COLUMN_DIR DIRECT /end RECORD_LAYOUT
/begin RECORD_LAYOUT Lookup1D_X_BOOLEAN AXIS_PTS_X 1 UBYTE INDEX_INCR DIRECT /end RECORD_LAYOUT
/begin RECORD_LAYOUT Lookup1D_BYTE FNC_VALUES 1 SBYTE COLUMN_DIR DIRECT /end RECORD_LAYOUT
/begin RECORD_LAYOUT Lookup1D_X_BYTE AXIS_PTS_X 1 SBYTE INDEX_INCR DIRECT /end RECORD_LAYOUT
/begin RECORD_LAYOUT Lookup1D_UBYTE FNC_VALUES 1 UBYTE COLUMN_DIR DIRECT /end RECORD_LAYOUT
/begin RECORD_LAYOUT Lookup1D_X_UBYTE AXIS_PTS_X 1 UBYTE INDEX_INCR DIRECT /end RECORD_LAYOUT
/begin RECORD_LAYOUT Lookup1D_UWORD FNC_VALUES 1 UWORD COLUMN_DIR DIRECT /end RECORD_LAYOUT
/begin RECORD_LAYOUT Lookup1D_X_UWORD AXIS_PTS_X 1 UWORD INDEX_INCR DIRECT /end RECORD_LAYOUT
/begin RECORD_LAYOUT Lookup1D_WORD FNC_VALUES 1 SWORD COLUMN_DIR DIRECT /end RECORD_LAYOUT
/begin RECORD_LAYOUT Lookup1D_X_WORD AXIS_PTS_X 1 SWORD INDEX_INCR DIRECT /end RECORD_LAYOUT
/begin RECORD_LAYOUT Lookup1D_ULONG FNC_VALUES 1 ULONG COLUMN_DIR DIRECT /end RECORD_LAYOUT
/begin RECORD_LAYOUT Lookup1D_X_ULONG AXIS_PTS_X 1 ULONG INDEX_INCR DIRECT /end RECORD_LAYOUT
/begin RECORD_LAYOUT Lookup1D_SLONG FNC_VALUES 1 SLONG COLUMN_DIR DIRECT /end RECORD_LAYOUT
/begin RECORD_LAYOUT Lookup1D_X_LONG AXIS_PTS_X 1 SLONG INDEX_INCR DIRECT /end RECORD_LAYOUT
/begin RECORD_LAYOUT Lookup1D_FLOAT32_IEEE FNC_VALUES 1 FLOAT32_IEEE COLUMN_DIR DIRECT /end RECORD_LAYOUT
/begin RECORD_LAYOUT Lookup1D_X_FLOAT32_IEEE AXIS_PTS_X 1 FLOAT32_IEEE INDEX_INCR DIRECT /end RECORD_LAYOUT
/begin RECORD_LAYOUT Lookup1D_FLOAT64_IEEE FNC_VALUES 1 FLOAT64_IEEE COLUMN_DIR DIRECT /end RECORD_LAYOUT
/begin RECORD_LAYOUT Lookup1D_X_FLOAT64_IEEE AXIS_PTS_X 1 FLOAT64_IEEE INDEX_INCR DIRECT /end RECORD_LAYOUT
/begin RECORD_LAYOUT Lookup2D_BOOLEAN FNC_VALUES 1 UBYTE COLUMN_DIR DIRECT /end RECORD_LAYOUT
/begin RECORD_LAYOUT Lookup2D_X_BOOLEAN AXIS_PTS_X 1 UBYTE INDEX_INCR DIRECT /end RECORD_LAYOUT
/begin RECORD_LAYOUT Lookup2D_UBYTE FNC_VALUES 1 UBYTE COLUMN_DIR DIRECT /end RECORD_LAYOUT
/begin RECORD_LAYOUT Lookup2D_X_UBYTE AXIS_PTS_X 1 UBYTE INDEX_INCR DIRECT /end RECORD_LAYOUT
/begin RECORD_LAYOUT Lookup2D_BYTE FNC_VALUES 1 SBYTE COLUMN_DIR DIRECT /end RECORD_LAYOUT
/begin RECORD_LAYOUT Lookup2D_X_BYTE AXIS_PTS_X 1 SBYTE INDEX_INCR DIRECT /end RECORD_LAYOUT
/begin RECORD_LAYOUT Lookup2D_UWORD FNC_VALUES 1 UWORD COLUMN_DIR DIRECT /end RECORD_LAYOUT
/begin RECORD_LAYOUT Lookup2D_X_UWORD AXIS_PTS_X 1 UWORD INDEX_INCR DIRECT /end RECORD_LAYOUT
/begin RECORD_LAYOUT Lookup2D_WORD FNC_VALUES 1 SWORD COLUMN_DIR DIRECT /end RECORD_LAYOUT
/begin RECORD_LAYOUT Lookup2D_X_WORD AXIS_PTS_X 1 SWORD INDEX_INCR DIRECT /end RECORD_LAYOUT
/begin RECORD_LAYOUT Lookup2D_ULONG FNC_VALUES 1 ULONG COLUMN_DIR DIRECT /end RECORD_LAYOUT
/begin RECORD_LAYOUT Lookup2D_X_ULONG AXIS_PTS_X 1 ULONG INDEX_INCR DIRECT /end RECORD_LAYOUT
/begin RECORD_LAYOUT Lookup2D_LONG FNC_VALUES 1 SLONG COLUMN_DIR DIRECT /end RECORD_LAYOUT
/begin RECORD_LAYOUT Lookup2D_X_LONG AXIS_PTS_X 1 SLONG INDEX_INCR DIRECT /end RECORD_LAYOUT
/begin RECORD_LAYOUT Lookup2D_FLOAT32_IEEE FNC_VALUES 1 FLOAT32_IEEE COLUMN_DIR DIRECT /end RECORD_LAYOUT
/begin RECORD_LAYOUT Lookup2D_X_FLOAT32_IEEE AXIS_PTS_X 1 FLOAT32_IEEE INDEX_INCR DIRECT /end RECORD_LAYOUT
/begin RECORD_LAYOUT Lookup2D_FLOAT64_IEEE FNC_VALUES 1 FLOAT64_IEEE COLUMN_DIR DIRECT /end RECORD_LAYOUT
/begin RECORD_LAYOUT Lookup2D_X_FLOAT64_IEEE AXIS_PTS_X 1 FLOAT64_IEEE INDEX_INCR DIRECT /end RECORD_LAYOUT
/begin CHARACTERISTIC etcModeCmd "" VALUE 0x0000e180 Scalar_UWORD 0 F28379D_benchTest_CPU1_CM_etcModes_etcModes 0 3 /end CHARACTERISTIC
/begin CHARACTERISTIC etcSubModeCmd "" VALUE 0x0000e181 Scalar_UWORD 0 F28379D_benchTest_CPU1_CM_etcSubModes_etcSubModes 0 4 /end CHARACTERISTIC
/begin CHARACTERISTIC motorAPWM "" VALUE 0x0000e182 Scalar_UWORD 0 F28379D_benchTest_CPU1_CM_uint16_pct 0.0 100.0 /end CHARACTERISTIC
/begin CHARACTERISTIC motorBPWM "" VALUE 0x0000e183 Scalar_UWORD 0 F28379D_benchTest_CPU1_CM_uint16_pct 0.0 100.0 /end CHARACTERISTIC
/begin CHARACTERISTIC motorEnable "" VALUE 0x0000e184 Scalar_UWORD 0 F28379D_benchTest_CPU1_CM_uint16_boolean 0.0 1.0 /end CHARACTERISTIC
/begin CHARACTERISTIC motorPWMFreq "" VALUE 0x0000e185 Scalar_UWORD 0 F28379D_benchTest_CPU1_CM_uint16_Hz 0.0 60000.0 /end CHARACTERISTIC
/begin COMPU_METHOD F28379D_benchTest_CPU1_CM_etcModes_etcModes "Enumerated data type: etcModes" TAB_VERB "%0.6" "etcModes" /* Conversion Table */ COMPU_TAB_REF VTAB_FOR_F28379D_benchTest_CPU1_CM_etcModes_etcModes /end COMPU_METHOD
/begin COMPU_VTAB /* Name of Table */ VTAB_FOR_F28379D_benchTest_CPU1_CM_etcModes_etcModes "Enumerated data type: etcModes" TAB_VERB /* Number of Elements */ 4 0 "etcModes_ESTOP" 1 "etcModes_Standby" 2 "etcModes_Run" 3 "etcModes_Diag" /end COMPU_VTAB
/begin COMPU_METHOD F28379D_benchTest_CPU1_CM_etcSubModes_etcSubModes "Enumerated data type: etcSubModes" TAB_VERB "%0.6" "etcSubModes" /* Conversion Table */ COMPU_TAB_REF VTAB_FOR_F28379D_benchTest_CPU1_CM_etcSubModes_etcSubModes /end COMPU_METHOD
/begin COMPU_VTAB /* Name of Table */ VTAB_FOR_F28379D_benchTest_CPU1_CM_etcSubModes_etcSubModes "Enumerated data type: etcSubModes" TAB_VERB /* Number of Elements */ 5 0 "etcSubModes_Disabled" 1 "etcSubModes_Normal" 2 "etcSubModes_Calibration" 3 "etcSubModes_PWMControl" 4 "etcSubModes_PositionControl" /end COMPU_VTAB
/begin COMPU_METHOD F28379D_benchTest_CPU1_CM_uint16_pct "Q = V" RAT_FUNC "%5.0" "pct" COEFFS 0 1 0 0 0 1 /end COMPU_METHOD
/begin COMPU_METHOD F28379D_benchTest_CPU1_CM_uint16_boolean "Q = V" RAT_FUNC "%5.0" "boolean" COEFFS 0 1 0 0 0 1 /end COMPU_METHOD
/begin COMPU_METHOD F28379D_benchTest_CPU1_CM_uint16_Hz "Q = V" RAT_FUNC "%5.0" "Hz" COEFFS 0 1 0 0 0 1 /end COMPU_METHOD
/begin GROUP F28379D_benchTest_CPU1 "F28379D_benchTest_CPU1" /* Root */ ROOT /begin SUB_GROUP Root_Application /end SUB_GROUP /end GROUP
/begin GROUP Root_Application "F28379D_benchTest_CPU1/Application" /begin SUB_GROUP S1_ETCControl /end SUB_GROUP /end GROUP
/begin GROUP S1_ETCControl "F28379D_benchTest_CPU1/Application/ETCControl" /begin SUB_GROUP S4_SystemControl /end SUB_GROUP /end GROUP
/begin GROUP S4_SystemControl "F28379D_benchTest_CPU1/Application/ETCControl/SystemControl" /begin SUB_GROUP S9_modeControl S9_motorControl /end SUB_GROUP /end GROUP
/begin GROUP S9_modeControl "F28379D_benchTest_CPU1/Application/ETCControl/SystemControl/modeControl" /begin REF_CHARACTERISTIC etcModeCmd etcSubModeCmd /end REF_CHARACTERISTIC /end GROUP
/begin GROUP S9_motorControl "F28379D_benchTest_CPU1/Application/ETCControl/SystemControl/motorControl" /begin REF_CHARACTERISTIC motorAPWM motorBPWM motorEnable motorPWMFreq /end REF_CHARACTERISTIC /end GROUP
/end MODULE
/end PROJECT
/* (add any file trailer comments here) */
/* EOF F28379D_benchTest_CPU1.a2l */
